## drivers/misc/lens/Kconfig
```kconfig
#
# Lens communication driver configuration
#
config NXLENS_COMM_MAN
	bool "Nx series lens SPI communication manager driver"
	depends on NXLENS
	default n
	help
	  This driver is SPI communication manager for NX series lens.
```

## drivers/misc/shutter/Kconfig
```kconfig
#
# SHUTTER driver configuration
#
config SHUTTER_COPAL_AFE3141
	bool "AFE3141 Focalplane Shutter Driver"
	depends on SHUTTER
	help
	  This is focalplane shutter driver of Copal Ltd.
	  This Driver is sample driver. (Do not use this)

config SHUTTER_ALLEGRO
	bool "Allegro Focalplane Shutter Driver"
	depends on SHUTTER
	help
	  This is focalplane shutter driver of Samsung Ltd.

config SHUTTER_COPAL
	bool "Copal Focalplane Shutter Driver"
	depends on SHUTTER
	help
	  This is focalplane shutter driver of Copal Ltd.
```

## drivers/misc/sprotocol/Kconfig
```kconfig
#
# Lens communication driver configuration
#
config SLAVE_PROTOCOL
	bool "Slave Protocol SPI communication manager driver"
```

## drivers/misc/str/Kconfig
```kconfig
#config TEST_PWM_DEVICE
#	bool "Test PWM Driver"
#	depends on TEST_PWM
#	help

config STROBE_CONTROLLER
	bool "Strobe controller driver"
	depends on STROBE
	help
	  This driver supports SPI transfering and PWM control for strobe.
	  
```

## drivers/pmu/Kconfig
```kconfig
#
# PMU driver configuration
#
# NOTE:  the reason this doesn't show SPI slave support is mostly that
# nobody's needed a slave side API yet.  The master-role API is not
# fully appropriate there, so it'd need some thought to do well.
#
menuconfig PMU
        bool "DRIMe4 Power Management"

if PMU
config PMU_SELECT
	bool "DRIMe4 ISP Power Management Select"
#	select DRIME4_OPENER
endif
```

## drivers/ptc/Kconfig
```kconfig
#
# SPI driver configuration
#
# NOTE:  the reason this doesn't show SPI slave support is mostly that
# nobody's needed a slave side API yet.  The master-role API is not
# fully appropriate there, so it'd need some thought to do well.
#
#menuconfig PTC
#	bool "DRIMe4 PTC "

#if PTC
config PTC_DEV
	bool "DRIMe4 Pulse Trigger Counter device driver"
#endif
```

## drivers/pwm/Kconfig
```kconfig
#
# SPI driver configuration
#
# NOTE:  the reason this doesn't show SPI slave support is mostly that
# nobody's needed a slave side API yet.  The master-role API is not
# fully appropriate there, so it'd need some thought to do well.
#
menuconfig HT_PWM
        bool "DRIMe4 HT_PWM "

if HT_PWM
config HT_PWM_CTRL
        bool "DRIMe4 Hardware Trigger PWM device driver"
config HT_PWM_UMODE
        bool "User Mode DRIMe4 Hardware Trigger PWM Support"
				 select HT_PWM_CTRL
endif
```

## drivers/rmu/Kconfig
```kconfig
#
# Reset Management Unit driver configuration
#
# NOTE:  the reason this doesn't show SPI slave support is mostly that
# nobody's needed a slave side API yet.  The master-role API is not
# fully appropriate there, so it'd need some thought to do well.
#

config RMU_DEV
	bool "DRIMe4 Reset Management Unit device driver"
```

## drivers/video/drime4/Kconfig
```kconfig
#
# Video DRIMe4 configuration
#

config FB_DRIME4
	tristate "DRIMe4 LCD FB "
	depends on FB
	select FB_CFB_FILLRECT
	select FB_CFB_COPYAREA
	select FB_CFB_IMAGEBLIT
	---help---
	  Frame buffer driver for Fujitsu Carmine/Coral-P(A)/Lime controllers.
source "drivers/video/drime4/lcd_panel_manager/Kconfig"
```

## drivers/video/drime4/lcd_panel_manager/Kconfig
```kconfig
#
# selection configurations for LCD Panel Manager
#

config DRIME4_LCD_PANEL_MANAGER
	bool "DRIMe4 LCD Panel Manager"
	depends on DRM_DRIME4_DP_LCD
	---help---
	  This is a LCD Panel Manager for DRIMe4

config MAIN_LCD_1_SELECT
	bool "Main LCD 1 selection"
	depends on DRIME4_LCD_PANEL_MANAGER
	---help---
	  This is a Main LCD 1 selection.

	source "drivers/video/drime4/lcd_panel_manager/mlcd_1_panel/Kconfig"

config MAIN_LCD_2_SELECT
	bool "Main LCD 2 selection"
	depends on DRIME4_LCD_PANEL_MANAGER
	---help---
	  This is a Main LCD 2 selection.

	source "drivers/video/drime4/lcd_panel_manager/mlcd_2_panel/Kconfig"

config SUB_LCD_SELECT
	bool "Sub LCD selection"
	depends on DRIME4_LCD_PANEL_MANAGER
	---help---
	  This is a Sub LCD selection.

	source "drivers/video/drime4/lcd_panel_manager/slcd_panel/Kconfig"

config LPM_DEBUG_MODE
	bool "LCD Panel Manager debug mode"
	depends on DRIME4_LCD_PANEL_MANAGER
	---help---
	  This is a debug mode for LCD Panel Manager
```

## drivers/video/drime4/lcd_panel_manager/mlcd_1_panel/Kconfig
```kconfig
#
# selection configurations for Main LCD 1 Panel Selection
#

#choice
#	prompt "MLCD1 selection"
#	depends on MAIN_LCD_1_SELECT
#	---help---
#	  Main LCD1 selection

config MLCD_1_PANEL_1
	bool "SMD VGA 3.0 OLED"
	depends on MAIN_LCD_1_SELECT
	---help---
	  This is a LCD Panel 1.

config MLCD_1_PANEL_2
	bool "AUO VGA 3.0 LCD"
	depends on MAIN_LCD_1_SELECT
	---help---
	  This is a LCD Panel 2.

config MLCD_1_PANEL_3
	bool "SMD WVGA 3.3 Portrait LCD"
	depends on MAIN_LCD_1_SELECT
	---help---
	  This is a LCD Panel 3.

config MLCD_1_PANEL_4
	bool "SMD WVGA 3.5 Portrait LCD"
	depends on MAIN_LCD_1_SELECT
	---help---
	  This is a LCD Panel 4.

config MLCD_1_PANEL_5
	bool "Epson XGA EVF"
	depends on MAIN_LCD_1_SELECT
	---help---
	  This is a LCD Panel 5.

config MLCD_1_PANEL_6
	bool "eMagin XGA EVF"
	depends on MAIN_LCD_1_SELECT
	---help---
	  This is a LCD Panel 6.

config MLCD_1_PANEL_7
	bool "SMD WVGA 3.69 Portrait LCD"
	depends on MAIN_LCD_1_SELECT
	---help---
	  This is a LCD Panel 7.

config MLCD_1_PANEL_8
	bool "SMD WVGA 3.3 Portrait LCD, second version"
	depends on MAIN_LCD_1_SELECT
	---help---
	  This is a LCD Panel 8.

#endchoice
```

## drivers/video/drime4/lcd_panel_manager/mlcd_2_panel/Kconfig
```kconfig
#
# selection configurations for Main LCD 2 Panel Selection
#

choice
	prompt "MLCD2 selection"
	depends on MAIN_LCD_2_SELECT
	---help---
	  Main LCD2 selection

config MLCD_2_PANEL_1
	bool "eMagin XGA EVF"
	---help---
	  This is eMagin XGA EVF.

config MLCD_2_PANEL_2
	bool "Main LCD Panel 2"
	---help---
	  This is a LCD Panel 2.

config MLCD_2_PANEL_3
	bool "Main LCD Panel 3"
	---help---
	  This is a LCD Panel 3.

endchoice
```

## drivers/video/drime4/lcd_panel_manager/slcd_panel/Kconfig
```kconfig
#
# selection configurations for Sub LCD Panel Selection
#

choice
	prompt "SLCD selection"
	depends on SUB_LCD_SELECT
	---help---
	  Sub LCD selection

config SLCD_PANEL_1
	bool "720P YCC output for bridge IC"
	---help---
	  This is 720P YCC output for bridge IC.

config SLCD_PANEL_2
	bool "Sub LCD Panel 2"
	---help---
	  This is a LCD Panel 2.

config SLCD_PANEL_3
	bool "Sub LCD Panel 3"
	---help---
	  This is a LCD Panel 3.

endchoice
```
