## drivers/media/video/drime4/Kconfig
```kconfig
#
# D4 Video drivers configurations
#

config VIDEO_SAMSUNG
	bool "Samsung Multimedia Devices"
	#depends on VIDEO_CAPTURE_DRIVERS && VIDEO_V4L2
	select VIDEO_FIXED_MINOR_RANGES
	default n
	help
	  This is a representative video4linux configuration for Samsung multimedia devices.

menu "DRIMe4 video device drivers"

source "drivers/media/video/drime4/bma/Kconfig"
source "drivers/media/video/drime4/sma/Kconfig"
source "drivers/media/video/drime4/pp/Kconfig"
source "drivers/media/video/drime4/mipi/Kconfig"
source "drivers/media/video/drime4/ipcm/Kconfig"
source "drivers/media/video/drime4/ipcs/Kconfig"
source "drivers/media/video/drime4/ep/Kconfig"
#source "drivers/media/video/drime4/opener/Kconfig"
source "drivers/media/video/drime4/be/Kconfig"
source "drivers/media/video/drime4/bwm/Kconfig"
source "drivers/media/video/drime4/srp/Kconfig"
source "drivers/media/video/drime4/jpeg/Kconfig"
source "drivers/media/video/drime4/jxr/Kconfig"
source "drivers/media/video/drime4/mfc5x/Kconfig"
source "drivers/media/video/drime4/csm/Kconfig"

endmenu

config VIDEO_MISC_DEVICE
	bool "Samsung video misc devices"
	depends on CPU_DRIME4
	default n
	---help---

if VIDEO_MISC_DEVICE
config S5P_DEV_MFC
	bool "s5p_dev_mfc"
	depends on ARCH_DRIME4 || VIDEO_MISC_DEVICE
	help
	  Compile in platform device definitions for MFC
config ANON_ALLOCATOR
	bool "anon allocator"
	depends on ARCH_DRIME4 || VIDEO_MISC_DEVICE
	help
	  This is a driver for allocating buffers
endif #VIDEO_MISC_DEVICE


choice
	prompt "Fixed Memory Support"
	default DRIME4_MEM_CMA if (ARCH_DRIME4)
config DRIME4_MEM_CMA
        bool "Fixed memory through CMA"
	depends on ARCH_DRIME4
	select CMA
        help
          Use CMA(Contiguous memory allocator) to reserve machine specific memory.

endchoice
```

## drivers/media/video/drime4/be/Kconfig
```kconfig
#
# DSC drivers configurations
#

config DRIME4_BE
	tristate "Samsung Drime4 BE driver"
	help
		This is a device driver for Samsung Drime IV BayerEngine driver using ioctl.
```

## drivers/media/video/drime4/bma/Kconfig
```kconfig
#
# D4 BMA drivers configurations
#

config DRIME4_BMA
	tristate "Samsung DRIMe4 BMA driver"
	---help---
	  This is a BMA driver for Samsung DRIMe4
```

## drivers/media/video/drime4/bwm/Kconfig
```kconfig
#
# selection configurations for BWM(Bandwidth Manager)
#

config DRIME4_BWM
	tristate "Samsung DRIMe4 BWM(Bandwidth Manager)"
	---help---
	  This is a Bandwidth for DRIMe4
```

## drivers/media/video/drime4/csm/Kconfig
```kconfig
#
# selection configurations for CSM(Capture Sequence Manager)
#

config DRIME4_CSM
	tristate "Samsung DRIMe4 CSM(Capture Sequence Manager)"
	---help---
	  This is a Capture Sequence Manage for DRIMe4
```

## drivers/media/video/drime4/ep/Kconfig
```kconfig
#
# DSC drivers configurations
#

config DRIME4_EP
	tristate "Samsung DRIMe4 EP driver"
#        select VIDEO_DEV
#        select VIDEO_V4L2

	help
		This is a device driver for Samsung Drime IV EP driver using ioctl.
```

## drivers/media/video/drime4/ipcm/Kconfig
```kconfig
#
# D4 IPCM drivers configurations
#

config DRIME4_IPCM
	tristate "Samsung DRIMe4 IPCM driver"
	depends on VIDEO_DEV && VIDEO_V4L2 && ARCH_DRIME4
	---help---
	  This is a IPCM driver for Samsung DRIMe4
```

## drivers/media/video/drime4/ipcs/Kconfig
```kconfig
#
# DSC DRIMe4 IPCS drivers configurations
#

config DRIME4_IPCS
	tristate "Samsung DRIMe4 IPCS driver"
	depends on VIDEO_DEV && ARCH_DRIME4

	---help---
		This is IPCS device driver for Samsung Drime IV using ioctl
```

## drivers/media/video/drime4/jpeg/Kconfig
```kconfig
#
# D4 JPEG drivers configurations
#

config DRIME4_JPEG
	tristate "Samsung DRIMe4 JPEG driver"
	---help---
	  This is a JPEG driver for Samsung DRIMe4
```

## drivers/media/video/drime4/jxr/Kconfig
```kconfig
#
# D4 JPEG_XR drivers configurations
#

config DRIME4_JPEG_XR
	tristate "Samsung DRIMe4 JPEG_XR driver"
	---help---
	  This is a JPEG_XR driver for Samsung DRIMe4
```

## drivers/media/video/drime4/mfc5x/Kconfig
```kconfig
#
# Configuration for Multi Format Codecs (MFC)
#

config VIDEO_MFC5X
	bool "Samsung MFC (Multi Format Codec - FIMV 5.x) Driver"
	#depends on VIDEO_SAMSUNG && CPU_DRIME4
	depends on CPU_DRIME4
	default n
	---help---
	  This is a Samsung Multi Format Codecs (MFC) FIMV V5.x - driver for Samsung DRIME4

config VIDEO_MFC_MAX_INSTANCE
	int "Maximum size of MFC instance (1-4)"
	range 1 4
	depends on VIDEO_MFC5X
	default 1

config VIDEO_MFC_MEM_PORT_COUNT
	int "Default number of MFC memory ports (1-2)"
	range 1 2
	depends on VIDEO_MFC5X
	default 2

config VIDEO_MFC_VCM_UMP
	bool "Support UMP over VCM for MFC"
	depends on VIDEO_MFC5X && VCM_MMU && VCM_VMM && VIDEO_UMP
	default y

config VIDEO_MFC5X_DEBUG
	bool "MFC driver debug message"
	depends on VIDEO_MFC5X
	default n

config VIDEO_MFC5X_MEASURE_CODING_TIME
	bool "MFC driver debug (timing) message"
	depends on VIDEO_MFC5X
	default n
	---help---
	   Compile a set of codes that measure the duration from "command start" to "irq occurrence"


comment "Reserved memory configurations"
config VIDEO_SAMSUNG_MEMSIZE_MFC
	int "Memory size in kbytes for MFC"
	depends on ((VIDEO_MFC5X) && (VIDEO_MFC_MEM_PORT_COUNT = 1))
	default "65536"

config VIDEO_SAMSUNG_MEMSIZE_MFC0
	int "Memory size in kbytes for MFC port0"
	depends on ((VIDEO_MFC5X) && (!VIDEO_MFC_MEM_PORT_COUNT = 1))
	default "32768"

config VIDEO_SAMSUNG_MEMSIZE_MFC1
	int "Memory size in kbytes for MFC port1"
	depends on ((VIDEO_MFC5X) && (!VIDEO_MFC_MEM_PORT_COUNT = 1))
	default "32768"
```

## drivers/media/video/drime4/mipi/Kconfig
```kconfig
#
# D4 MIPI drivers configurations
#

config DRIME4_MIPI
	tristate "Samsung DRIMe4 MIPI driver"
	depends on DRIME4_PP_CORE && DRIME4_PP_SSIF
	---help---
	  This is a MIPI driver for Samsung DRIMe4
```

## drivers/media/video/drime4/opener/Kconfig
```kconfig
#
# D4 Driver Opener drivers configurations
#

config DRIME4_OPENER
	tristate "Samsung DRIMe4 UDD Opener driver"
	depends on PMU_SELECT
	---help---
	  This is a DRIMe4 UDD Opener driver for Samsung DRIMe4
```

## drivers/media/video/drime4/pp/Kconfig
```kconfig
#
# D4 PP drivers configurations
#

source "drivers/media/video/drime4/pp/pp_ssif/Kconfig"
source "drivers/media/video/drime4/pp/pp_core/Kconfig"
source "drivers/media/video/drime4/pp/pp_3a/Kconfig"
#source "drivers/media/video/drime4/pp/pp_capture_fw/Kconfig"
```

## drivers/media/video/drime4/pp/pp_3a/Kconfig
```kconfig
#
# D4 PP 3A drivers configurations
#

config DRIME4_PP_3A
	tristate "Samsung DRIMe4 PP 3A driver"
	depends on VIDEO_DEV && VIDEO_V4L2 && ARCH_DRIME4  && DRIME4_PP_CORE
	---help---
	  This is a PP 3a driver for Samsung DRIMe4
```

## drivers/media/video/drime4/pp/pp_core/Kconfig
```kconfig
#
# D4 PP Core drivers configurations
#

config DRIME4_PP_CORE
	tristate "Samsung DRIMe4 PP Core driver"
	depends on VIDEO_DEV && VIDEO_V4L2 && ARCH_DRIME4
	---help---
	  This is a PP Core driver for Samsung DRIMe4
```

## drivers/media/video/drime4/pp/pp_ssif/Kconfig
```kconfig
#
# D4 PP SSIF drivers configurations
#

config DRIME4_PP_SSIF
	tristate "Samsung DRIMe4 PP ssif driver"
	depends on VIDEO_DEV && VIDEO_V4L2 && ARCH_DRIME4
	---help---
	  This is a PP ssif driver for Samsung DRIMe4
```

## drivers/media/video/drime4/sma/Kconfig
```kconfig
#
# D4 SMA drivers configurations
#

config DRIME4_SMA
	tristate "Samsung DRIMe4 SMA driver"
	---help---
	  This is a SMA driver for Samsung DRIMe4
```

## drivers/media/video/drime4/srp/Kconfig
```kconfig
#
# D4 SRP drivers configurations
#

config DRIME4_SRP
	tristate "Samsung DRIMe4 SRP driver"
	---help---
	  This is a SRP driver for Samsung DRIMe4
```
